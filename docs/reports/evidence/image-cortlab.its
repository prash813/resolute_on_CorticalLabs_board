## docs/reports/evidence/image-cortlab.its
```
/*
 * Simple U-Boot uImage source file containing a single kernel, ramdisk and FDT blob
 */

/dts-v1/;

/ {
    description = "Simple image with single Linux kernel, ramdisk and FDT blob";
    #address-cells = <1>;

    images {
        kernel-1 {
            description = "Ubuntu kernel";
            data = /incbin/("Image_resolute_kria");
            type = "kernel";
            arch = "arm64";
            os = "linux";
            compression = "none";
            load = <0x00200000>;
            entry = <0x00200000>;
            hash-1 {
                algo = "sha1";
            };
        };
        ramdisk-1 {
            description = "Ubuntu ramdisk";
            data = /incbin/("ramdisk_1");
            type = "ramdisk";
            arch = "arm64";
            os = "linux";
            compression = "none";
            hash-1 {
                algo = "sha1";
            };
        };
        system.dtb {
            description = "Flattened device tree blob - corticallab board";
            data = /incbin/("system.dtb");
            type = "flat_dt";
            arch = "arm64";
            compression = "none";
            load = <0x44000000>;
            hash-1 {
                algo = "sha1";
            };
        };
    };

    configurations {
        default = "conf-corticallab-board";
        conf-corticallab-board {
            description = "Boot Ubuntu on Cortical's board kria SOM+custom carrier";
            kernel = "kernel-1";
            ramdisk = "ramdisk-1";
            fdt = "system.dtb";
            hash-1 {
                algo = "sha1";
            };
        };
    };
};
```
